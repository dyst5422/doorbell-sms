## firmware-c6/sdkconfig.defaults
```kconfig
# Zigbee End Device configuration
CONFIG_ZB_ENABLED=y
CONFIG_ZB_RADIO_NATIVE=y
CONFIG_ZB_ZED=y
CONFIG_IEEE802154_ENABLED=y

# FreeRTOS
CONFIG_FREERTOS_HZ=100
CONFIG_FREERTOS_UNICORE=y

# Stack sizes
CONFIG_ESP_MAIN_TASK_STACK_SIZE=8192
CONFIG_PTHREAD_TASK_STACK_SIZE_DEFAULT=4096

# Partition table
CONFIG_PARTITION_TABLE_CUSTOM=y

# Console
CONFIG_ESP_CONSOLE_USB_SERIAL_JTAG=y

# Flash size
CONFIG_ESPTOOLPY_FLASHSIZE_4MB=y

# Disable unused features to save flash
CONFIG_BT_ENABLED=n
CONFIG_LWIP_IPV6=n
CONFIG_NVS_ENCRYPTION=n

# Logging
CONFIG_LOG_DEFAULT_LEVEL_INFO=y
CONFIG_LOG_MAXIMUM_LEVEL_DEBUG=y

# Power management
CONFIG_PM_ENABLE=y
CONFIG_PM_LIGHT_SLEEP_CALLBACKS=y
CONFIG_PM_POWER_DOWN_CPU_IN_LIGHT_SLEEP=y
CONFIG_PM_POWER_DOWN_PERIPHERAL_IN_LIGHT_SLEEP=y
CONFIG_FREERTOS_USE_TICKLESS_IDLE=y
```
